## app/src/applications/baby_alarm/Kconfig
```kconfig
module = ZSW_BABY_ALARM_APP
module-str = ZSW_BABY_ALARM_APP
source "subsys/logging/Kconfig.template.log_config"
```

## app/src/applications/remote_shutter/Kconfig
```kconfig
module = ZSW_REMOTE_SHUTTER_APP
module-str = ZSW_REMOTE_SHUTTER_APP
source "subsys/logging/Kconfig.template.log_config"
```

## app/src/edge_impulse/Kconfig
```kconfig
module = ZSW_EDGE_IMPULSE
module-str = ZSW_EDGE_IMPULSE
source "subsys/logging/Kconfig.template.log_config"
```
